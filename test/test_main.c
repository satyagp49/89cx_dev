#include <stdio.h>
#include <string.h>
/* CharData is a two dimensional constant array that holds the 8-bit column values of
   individual rows for ASCII characters that are to be displayed on a 8x8 matrix format.
*/
const unsigned short CharData[][8] ={
{0b00000000, 0b00000000, 0b00000000, 0b00000000, 0b00000000, 0b00000000, 0b00000000, 0b00000000},
{0b00000100, 0b00000100, 0b00000100, 0b00000100, 0b00000100, 0b00000100, 0b00000000, 0b00000100},
{0b00001010, 0b00001010, 0b00001010, 0b00000000, 0b00000000, 0b00000000, 0b00000000, 0b00000000},
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{0b00000000, 0b00000000, 0b00000000, 0b00001010, 0b00011110, 0b00010100, 0b00000000, 0b00000000}
};

unsigned int DisplayBuffer[]={0,0,0,0,0,0,0,0};
unsigned int speed;
short i, l, k, ShiftAmount, scroll, temp, shift_step=1, StringLength;
char message[]="A";
char index_1;
int main() {
//     CMCON = 0x07;   // Disable comparators
//     ADCON0 = 0x00; // Select ADC channel AN0
//     ADCON1 = 0b00001110;  // RA0 as analog input
//     TRISC = 0x00;
//     TRISB = 0xFF;
//     TRISA = 0x01;
    StringLength = strlen(message) ;
    {
        for (k=0; k<StringLength; k++){
            for (scroll=0; scroll<(8/shift_step); scroll++) {
                printf ("\n(DisplayBuffer[ShiftAmount] << shift_step) | (temp >> ((8-shift_step)-scroll*shift_step))");
                for (ShiftAmount=0; ShiftAmount<8; ShiftAmount++){
                    index_1 = message[k];
                    temp = CharData[index_1 - 32][ShiftAmount];
                    //printf ("\nCharData[%d - 32][%d] = %x", index_1, ShiftAmount, CharData[index_1 - 32][ShiftAmount]);
                    printf ("\n\t(%x << %d) \t   | (%x >> ((8-%d)-%d*%d)) = %x | %x",DisplayBuffer[ShiftAmount], shift_step,temp,shift_step,scroll,shift_step, \
                    (DisplayBuffer[ShiftAmount] << shift_step), (temp >> ((8-shift_step)-scroll*shift_step)));
                    DisplayBuffer[ShiftAmount] = (DisplayBuffer[ShiftAmount] << shift_step)| (temp >> ((8-shift_step)-scroll*shift_step));
                    //DisplayBuffer[ShiftAmount] = (DisplayBuffer[ShiftAmount] >> shift_step)| (temp << ((8-shift_step)-scroll*shift_step));
                    
                }
                //speed = 10+ADC_Read(0)/10;
                speed = 1;
                for(l=0; l<speed;l++){
                    printf ("\nDisplayBuffer: ");
                    for (i=0; i<8; i++) {
                        //send_data(DisplayBuffer[i]);
                        printf (" %x", DisplayBuffer[i]);
                        //CD4017_Clk = 1;
                        //CD4017_Clk = 0;
                        //Delay_ms(1);
                    }  // i
                    //CD4017_Rst = 1;
                    //CD4017_Rst = 0;
                } // l
                printf ("\n");
            } // scroll
        } // k

    }
    printf ("\n");
    return 0;
}